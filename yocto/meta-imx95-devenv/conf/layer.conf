## yocto/meta-imx95-devenv/conf/layer.conf
```bitbake
BBPATH .= ":${LAYERDIR}"
BBFILES += "${LAYERDIR}/recipes-*/*/*.bb ${LAYERDIR}/recipes-*/*/*.bbappend"
BBFILE_COLLECTIONS += "imx95-devenv"
BBFILE_PATTERN_imx95-devenv = "^${LAYERDIR}/"
BBFILE_PRIORITY_imx95-devenv = "20"
LAYERDEPENDS_imx95-devenv = "core freescale-layer fsl-bsp-release"
LAYERSERIES_COMPAT_imx95-devenv = "wrynose"
```

## zephyr/modules/devenv/Kconfig
```kconfig
# SPDX-License-Identifier: Apache-2.0
menu "imx95-devenv drivers"

config UHC_CI_EHCI
	bool "ChipIdea EHCI USB host controller (i.MX95 USB2)"
	default y
	depends on DT_HAS_DEVENV_CI_EHCI_ENABLED
	depends on UHC_DRIVER
	help
	  EHCI host driver for the ChipIdea USB 2.0 controller with integrated
	  transaction translator (i.MX95 USB2), written for imx95-devenv.
	  Control, bulk and interrupt transfers; no isochronous.

if UHC_CI_EHCI

config UHC_CI_EHCI_THREAD_STACK_SIZE
	int "Driver thread stack size"
	default 2048

config UHC_CI_EHCI_THREAD_PRIORITY
	int "Driver thread priority"
	default 2

endif

config VEHCI
	bool "Virtual EHCI host controller (\"Wimmo\")"
	help
	  Emulate an EHCI host controller for a standard EHCI driver on another
	  processor: register page in shared memory, schedules in the host's
	  memory, a level interrupt. The integration supplies the transport
	  (struct vehci_transport). See include/vehci/vehci.h.

if VEHCI

config VEHCI_THREAD_STACK_SIZE
	int "Emulation thread stack size"
	default 2048

config VEHCI_ADAPTIVE_POLL
	bool "Sleep between polls when idle"
	default y
	help
	  Poll the register page and schedules continuously while there is
	  activity; after 2 ms without any, sleep one tick between polls so
	  the core can idle. Off: poll all the time (lowest priority).

config VEHCI_XLAT
	bool "Translator to the physical USB controller"
	depends on UHC_CI_EHCI
	help
	  The device on the physical root port appears on the Wimmo hub's
	  port; the host's qTDs for it become physical qTDs (raw interface of
	  uhc_ci_ehci). USB addresses and data toggles pass through.

config VEHCI_XLAT_BOUNCE
	bool "Bounce data through M7 memory by default (instead of zero-copy)"
	depends on VEHCI_XLAT

config VEHCI_XLAT_KEYS
	bool "Print key presses of boot keyboards passing through"
	default y
	depends on VEHCI_XLAT

module = VEHCI
module-str = vehci
source "subsys/logging/Kconfig.template.log_config"

endif

endmenu
```

## zephyr/modules/devenv/dts/bindings/usb/devenv,ci-ehci.yaml
```yaml
# SPDX-License-Identifier: Apache-2.0
description: |
  ChipIdea USB 2.0 controller in EHCI host mode with integrated transaction
  translator (i.MX95 USB2). First reg entry: controller registers (ID at 0x000,
  EHCI capability registers at 0x100). Second: the USB non-core block (USBNC).

  EHCI data structures (frame list, queue heads, transfer descriptors) live in
  a pool the controller can reach by DMA. On the i.MX95 M7 that is DTCM, which
  is never cached on the M7; devenv,pool gives its M7 address and size and
  devenv,pool-bus-addr where the controller sees it (DTCM on the system bus).

compatible: "devenv,ci-ehci"

include: [base.yaml]

properties:
  reg:
    required: true

  interrupts:
    required: true

  devenv,pool:
    type: array
    required: true
    description: M7 address and size of the DMA pool for EHCI structures

  devenv,pool-bus-addr:
    type: int
    required: true
    description: address of the same pool as seen by the controller

  disable-over-current:
    type: boolean
    description: ignore the over-current input (EVK Type-A port has none wired)
```
